/* Copyright (c) 2016-2018, The Linux Foundation. All rights reserved.
 *
 * This program is free software; you can redistribute it and/or modify
 * it under the terms of the GNU General Public License version 2 and
 * only version 2 as published by the Free Software Foundation.
 *
 * This program is distributed in the hope that it will be useful,
 * but WITHOUT ANY WARRANTY; without even the implied warranty of
 * MERCHANTABILITY or FITNESS FOR A PARTICULAR PURPOSE.  See the
 * GNU General Public License for more details.
 */

&pm660l_l7 {
	/delete-property/ parent-supply;
	qcom,init-voltage = <3125000>;
	regulator-always-on;
};

&pm660l_l8 {
	regulator-min-microvolt = <2800000>;
	regulator-max-microvolt = <2800000>;
};
