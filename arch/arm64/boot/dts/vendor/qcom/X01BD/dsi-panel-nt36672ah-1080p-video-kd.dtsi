/* Copyright (c) 2013, The Linux Foundation. All rights reserved.
 *
 * This  program is free software; you can redistribute it and/or modify
 * it under the terms of the GNU General Public License version 2 and
 * only version 2 as published by the Free Software Foundation.
 *
 * This program is distributed in the hope that it will be useful,
 * but WITHOUT ANY WARRANTY; without even the implied warranty of
 * MERCHANTABILITY or FITNESS FOR A PARTICULAR PURPOSE.  See the
 * GNU General Public License for more details.
 */

/*---------------------------------------------------------------------------
 * This file is autogenerated file using gcdb parser. Please do not edit it.
 * Update input XML file to add a new entry or update variable in this file
 * VERSION = "1.0"
 *---------------------------------------------------------------------------*/
&mdss_mdp {
    dsi_nt36672ah_1080p_video_kd: qcom,mdss_dsi_nt36672ah_1080p_video_kd {
        qcom,mdss-dsi-panel-name = "nt36672ah 1080p video mode dsi kd panel";
        qcom,mdss-dsi-panel-controller = <&mdss_dsi0>;
        qcom,mdss-dsi-panel-type = "dsi_video_mode";
        qcom,mdss-dsi-panel-destination = "display_1";
        qcom,mdss-dsi-panel-framerate = <60>;
        
        qcom,mdss-dsi-pan-enable-dynamic-bitclk;
        qcom,mdss-dsi-dynamic-bitclk_freq = <798240576 801594528 804948480
            808302432 811656384>;
        
        qcom,mdss-dsi-pan-enable-dynamic-fps;
        qcom,mdss-dsi-pan-fps-update = "dfps_immediate_porch_mode_vfp";
        
        qcom,mdss-dsi-virtual-channel-id = <0>;
        qcom,mdss-dsi-stream = <0>;
        qcom,mdss-dsi-panel-width = <1080>;
        qcom,mdss-dsi-panel-height = <2280>;
        qcom,mdss-pan-physical-width-dimension = <68>;
        qcom,mdss-pan-physical-height-dimension = <143>;
        
        qcom,mdss-dsi-h-front-porch = <120>;
        qcom,mdss-dsi-h-back-porch = <120>;
        qcom,mdss-dsi-h-pulse-width = <8>;
        qcom,mdss-dsi-h-sync-skew = <0>;
        qcom,mdss-dsi-v-back-porch = <8>;
        qcom,mdss-dsi-v-front-porch = <10>;
        qcom,mdss-dsi-v-pulse-width = <2>;
        qcom,mdss-dsi-h-left-border = <0>;
        qcom,mdss-dsi-h-right-border = <0>;
        qcom,mdss-dsi-v-top-border = <0>;
        qcom,mdss-dsi-v-bottom-border = <0>;
        qcom,mdss-dsi-bpp = <24>;
        
        /* ═══════════════════════════════════════════════════════
           ★★★ ULPS ПОЛНОСТЬЮ ОТКЛЮЧЕНО — НЕТ НИКАКИХ ФЛАГОВ ★★★
           ═══════════════════════════════════════════════════════ */
        
        qcom,mdss-dsi-color-order = "rgb_swap_rgb";
        qcom,mdss-dsi-underflow-color = <0xff>;
        qcom,mdss-dsi-border-color = <0>;
        
        qcom,mdss-dsi-on-command = [
            /* ... полная init sequence ... */
            15 01 00 00 00 00 02 FF 10
            15 01 00 00 00 00 02 FB 01
            /* ... остальные команды из оригинала ... */
            05 01 00 00 78 00 01 11
            05 01 00 00 14 00 01 29
        ];
        
        qcom,mdss-dsi-off-command = [
            05 01 00 00 14 00 02 28 00
            05 01 00 00 78 00 02 10 00
        ];
        
        qcom,mdss-dsi-on-command-state = "dsi_lp_mode";
        qcom,mdss-dsi-off-command-state = "dsi_lp_mode";
        
        qcom,mdss-dsi-h-sync-pulse = <1>;
        qcom,mdss-dsi-traffic-mode = "burst_mode";
        qcom,mdss-dsi-lane-map = "lane_map_0123";
        qcom,mdss-dsi-bllp-eof-power-mode;
        qcom,mdss-dsi-bllp-power-mode;
        qcom,mdss-dsi-lane-0-state;
        qcom,mdss-dsi-lane-1-state;
        qcom,mdss-dsi-lane-2-state;
        qcom,mdss-dsi-lane-3-state;
        
        qcom,mdss-dsi-panel-timings-phy-v2 = [
            26 21 09 0B 06 03 04 a0
            26 21 09 0B 06 03 04 a0
            26 21 09 0B 06 03 04 a0
            26 21 09 0B 06 03 04 a0
            26 20 0A 0B 06 03 04 a0
        ];
        qcom,mdss-dsi-t-clk-post = <0x0F>;
        qcom,mdss-dsi-t-clk-pre = <0x37>;
        
        qcom,mdss-dsi-bl-min-level = <1>;
        qcom,mdss-dsi-bl-max-level = <3259>;
        qcom,mdss-dsi-bl-default-level = <1140>;
        qcom,mdss-dsi-bl-pmic-control-type = "bl_ctrl_wled";
        
        qcom,mdss-dsi-dma-trigger = "trigger_sw";
        qcom,mdss-dsi-mdp-trigger = "none";
        
        qcom,mdss-dsi-reset-sequence = <1 10>, <0 10>, <1 20>;
        qcom,mdss-dsi-lp11-init;
        
        qcom,mdss-dsi-panel-hdr-enabled;
        qcom,mdss-dsi-panel-hdr-color-primaries = <14500 15500 32000
            17000 15500 30000 8000 3000>;
        qcom,mdss-dsi-panel-peak-brightness = <4200000>;
        qcom,mdss-dsi-panel-blackness-level = <3230>;
    };
};
