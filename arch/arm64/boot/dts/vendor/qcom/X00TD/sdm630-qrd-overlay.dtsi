/* Copyright (c) 2017-2018, The Linux Foundation. All rights reserved.
 *
 * This program is free software; you can redistribute it and/or modify
 * it under the terms of the GNU General Public License version 2 and
 * only version 2 as published by the Free Software Foundation.
 *
 * This program is distributed in the hope that it will be useful,
 * but WITHOUT ANY WARRANTY; without even the implied warranty of
 * MERCHANTABILITY or FITNESS FOR A PARTICULAR PURPOSE.  See the
 * GNU General Public License for more details.
 */

&qrd_batterydata {
	/delete-node/ qcom,qrd_msm8998_skuk_3000mah;
	#include "fg-gen3-batterydata-3292665_Huaqin_QL1650cos_5000mAh.dtsi"
};

&sdhc_1 {
	qcom,vdd-always-on;
};

&soc {
	gpio_keys {
		/delete-node/ home;
	};

	/delete-node/ hbtb;
};
