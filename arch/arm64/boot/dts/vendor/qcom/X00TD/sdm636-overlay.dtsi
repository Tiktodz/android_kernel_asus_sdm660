/* Copyright (c) 2017-2018, The Linux Foundation. All rights reserved.
 *
 * This program is free software; you can redistribute it and/or modify
 * it under the terms of the GNU General Public License version 2 and
 * only version 2 as published by the Free Software Foundation.
 *
 * This program is distributed in the hope that it will be useful,
 * but WITHOUT ANY WARRANTY; without even the implied warranty of
 * MERCHANTABILITY or FITNESS FOR A PARTICULAR PURPOSE.  See the
 * GNU General Public License for more details.
 */

#include "sdm660-overlay.dtsi"
#include "msm-pm660-overlay.dtsi"
#include "msm-pm660l-overlay.dtsi"
#include "msm-pm660l-rpm-regulator-overlay.dtsi"
#include "sdm660-regulator-overlay.dtsi"
#include "sdm660-common-overlay.dtsi"
#include "sdm660-camera-overlay.dtsi"
#include "msm-audio-overlay.dtsi"
#include "sdm660-audio-overlay.dtsi"
#include "sdm660-lpi-overlay.dtsi"
#include "dsi-panel-nt36672-1080p-video-txd.dtsi"
#include "dsi-panel-nt36672-1080p-video.dtsi"
#include "dsi-panel-td4310-1080p-video-txd.dtsi"
