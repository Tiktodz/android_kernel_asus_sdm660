## drivers/platform/xiaomi/Kconfig
```kconfig
comment "Xiaomi Optimization Features"

config PERF_HUMANTASK
	bool "Xiaomi's perf humantask feature"
	help
	  Support for Xiaomi's perf humantask feature.
```
